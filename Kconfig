## Kconfig
```kconfig
DT_COMPAT_ZMK_BLE_LEGO_HUB := zmk,behavior-ble-lego-hub

config ZMK_BEHAVIOR_BLE_LEGO_HUB
    bool
    default $(dt_compat_enabled,$(DT_COMPAT_ZMK_BEHAVIOR_BLE_LEGO_HUB))
    imply BT_CENTRAL
    imply BT_GATT_CLIENT

DT_COMPAT_ZMK_BLE_LEGO_MOTOR_CONTROL := zmk,behavior-ble-lego-motor-control

config ZMK_BEHAVIOR_BLE_LEGO_MOTOR_CONTROL
    bool
    default $(dt_compat_enabled,$(DT_COMPAT_ZMK_BEHAVIOR_BLE_LEGO_MOTOR_CONTROL))
    depends on BT_CENTRAL
    depends on BT_GATT_CLIENT
    depends on BT_HCI_HOST
```

## dts/bindings/zmk,behavior-ble-lego-hub.yaml
```yaml
# Copyright (c) 2025, George Norton
# SPDX-License-Identifier: MIT

description: Provides an interface for pairing with LEGO hubs.

compatible: "zmk,behavior-ble-lego-hub"

include: one_param.yaml
```

## dts/bindings/zmk,behavior-ble-lego-motor-control.yaml
```yaml
# Copyright (c) 2025, George Norton
# SPDX-License-Identifier: MIT

description: Provides an interface for controlling LEGO hubs.

compatible: "zmk,behavior-ble-lego-motor-control"

include: one_param.yaml

properties:
  speed:
    required: true
    type: int
    description: The new motor speed or relative speed adjustment
  relative:
    type: boolean
    description: If enabled the speed adjustment is relative rather than absolute
```
